## demos-smart-sensors/esp32-dht22/main/Kconfig.projbuild
```kconfig
menu "OEC smart sensor demo (DHT22)"

    config DEMO_DHT22_GPIO
        int "GPIO of the DHT22 data line"
        range 0 48
        default 4 if IDF_TARGET_ESP32S3
        default 23

    config DEMO_LEVEL
        int "Messaging level (the provisioning key level overrides it)"
        range 1 3
        default 3

    config DEMO_CONSOLE
        bool "Serial console commands stop and time"
        default y

    config DEMO_LCD147
        bool "ESP32-S3-LCD-1.47 board: readings on the display, temperature as LED colour"
        depends on IDF_TARGET_ESP32S3
        default n
        help
            The Waveshare ESP32-S3-LCD-1.47 and 1.47B boards: ST7789
            172 x 320 display (SPI on GPIO 39 ... 42, 45, backlight
            DEMO_LCD147_BL_GPIO) and an RGB LED on GPIO 38 (WS2812-type,
            bytes in the order R, G, B). Model and
            ProductCode name the board.

    config DEMO_LCD147_BL_GPIO
        int "GPIO of the display backlight (46: 1.47B with USB-C, 48: 1.47 with USB-A)"
        depends on DEMO_LCD147
        range 0 48
        default 46

    config DEMO_LCD147_FLIP
        bool "Rotate the display by 180 degrees"
        depends on DEMO_LCD147
        default n

    config DEMO_COLD_C
        int "Temperature shown blue (degrees Celsius, and below)"
        depends on DEMO_LCD147
        range -40 79
        default 15
        help
            The default of ColdTemperature in the Config context "Display".

    config DEMO_HOT_C
        int "Temperature shown red (degrees Celsius, and above; above DEMO_COLD_C)"
        depends on DEMO_LCD147
        range -39 80
        default 30
        help
            The default of HotTemperature in the Config context "Display".

    config DEMO_LED_BRIGHTNESS
        int "Brightness of the RGB LED (1 ... 255)"
        depends on DEMO_LCD147
        range 1 255
        default 48
        help
            The default of Brightness in the Config context "Display"
            (0 there switches the LED off).

endmenu
```
